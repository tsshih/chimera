## fw/boards/renode_riscv32/board.yml
```yaml
board:
  name: renode_riscv32
  full_name: Custom RISC-V 32-bit Renode Board
  vendor: custom
  socs:
    - name: riscv_virtual_renode
```

## fw/boards/renode_riscv32/renode_riscv32_defconfig
```kconfig
CONFIG_CONSOLE=y
CONFIG_SERIAL=y
CONFIG_UART_CONSOLE=y
CONFIG_XIP=y
CONFIG_SYS_CLOCK_TICKS_PER_SEC=100
```

## fw/west.yml
```yaml
manifest:
  defaults:
    remote: upstream

  remotes:
    - name: upstream
      url-base: https://github.com/zephyrproject-rtos

  group-filter:
    - -hal
    - +riscv

  projects:
    - name: zephyr
      remote: upstream
      revision: v4.4.2
      import:
        path-prefix: third_party
        name-allowlist:
          - picolibc
```
